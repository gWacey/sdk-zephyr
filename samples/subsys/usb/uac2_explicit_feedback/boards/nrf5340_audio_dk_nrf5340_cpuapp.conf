## samples/subsys/usb/uac2_explicit_feedback/boards/nrf5340_audio_dk_nrf5340_cpuapp.conf
```kconfig
# Enable SPI to configure the hardware codec
CONFIG_SPI=y

#Enable timer for asynchronous feedback
CONFIG_NRFX_TIMER=y

#Thread related configs
CONFIG_THREAD_MONITOR=y
CONFIG_THREAD_CUSTOM_DATA=y
CONFIG_THREAD_NAME=y
CONFIG_THREAD_STACK_INFO=y

# Hardware codec related configs
CONFIG_HW_CODEC_CIRRUS_LOGIC=y
CONFIG_NRF_AUDIO_CS47L63_DRIVER=y
```
