## modules/etsilc3/Kconfig
```kconfig
# Copyright (c) 2026 Nordic Semiconductor ASA
# SPDX-License-Identifier: Apache-2.0

config ZEPHYR_ETSILC3_MODULE
	bool

config ETSILC3
	bool "etsilc3 Support"
	help
	  Enable the Low Complexity Communication Codec (LC3)
```
